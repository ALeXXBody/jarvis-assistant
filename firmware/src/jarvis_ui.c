/*
 * JARVIS satellite UI — instrument HUD renderer (double-buffered).
 *
 * No LVGL: the app paints into an RGB565 framebuffer supplied by the BSP and
 * presents it each tick (bsp_display_flush). Vector work only: anti-aliased
 * annuli, ticks, a fading sweep, an audio-driven waveform ring, hairline
 * chrome, and metric anti-aliased text from jarvis_font.h (generated by
 * scripts/genfont.py from DejaVu Sans).
 *
 * Layout (800×1280 portrait):
 *   top bar        wordmark · voice-satellite label · wifi arcs · battery
 *   centre reactor glow disc + three annuli + tick ring + fading sweep
 *                  waveform ring while listening/speaking, twin sweep
 *                  while thinking
 *   state line     state word (56 px, tracked) + status line
 *   transcript     latest user turn + latest assistant reply, wrapped
 *   bottom bar     firmware version · turn latency
 *
 * Everything draws fully each frame into the back buffer; the flip is
 * tear-free. Cost is dominated by the background fill (~1 M px) and the
 * glow disc; measured comfortable at JARVIS_UI_FPS.
 */
#include "jarvis_ui.h"
#include "jarvis_config.h"
#include "jarvis_state.h"
#include "jarvis_audio.h"
#include "jarvis_turn.h"
#include "bsp_guition.h"
#include "jarvis_font.h"
#include "jarvis_settings.h"
#include "jarvis_wifi.h"
#include "jarvis_ws.h"
#include "freertos/semphr.h"

#include <string.h>
#include <stdio.h>
#include <math.h>
#include "esp_log.h"
#include "freertos/FreeRTOS.h"
#include "freertos/task.h"

static const char *TAG = "ui";

#define SCR_W BSP_LCD_H_RES
#define SCR_H BSP_LCD_V_RES

/* ---------------------------------------------------------------- palette --
 * Dark instrument scheme: deep charcoal, one accent hue per state, generous
 * spacing, thin hairlines. Nothing cartoonish.                                    */
#define RGB565(r, g, b) ((uint16_t)((((r) & 0xF8) << 8) | (((g) & 0xFC) << 3) | ((b) >> 3)))

#define C_BG         RGB565(9, 10, 12)     /* neutral near-black */
#define C_HAIR       RGB565(23, 29, 40)    /* hairlines */
#define C_TEXT_DIM   RGB565(104, 116, 133)
#define C_TEXT       RGB565(184, 192, 204)
#define C_TEXT_HI    RGB565(235, 240, 246)
#define C_IDLE       RGB565(63, 210, 255)  /* cyan  */
#define C_LISTEN     RGB565(235, 240, 245) /* white */
#define C_THINK      RGB565(255, 167, 52)  /* amber */
#define C_SPEAK      RGB565(96, 220, 143)  /* green */
#define C_ERR        RGB565(255, 84, 84)   /* red   */

static inline uint16_t mix565(uint16_t c1, uint16_t c2, int f)
{
    int r1 = (c1 >> 11) & 0x1F, g1 = (c1 >> 5) & 0x3F, b1 = c1 & 0x1F;
    int r2 = (c2 >> 11) & 0x1F, g2 = (c2 >> 5) & 0x3F, b2 = c2 & 0x1F;
    int r = (r1 * (255 - f) + r2 * f) / 255;
    int g = (g1 * (255 - f) + g2 * f) / 255;
    int b = (b1 * (255 - f) + b2 * f) / 255;
    return (uint16_t)((r << 11) | (g << 5) | b);
}

static inline void px_a(uint16_t *fb, int x, int y, uint16_t c2, int f)
{
    if ((unsigned)x >= (unsigned)SCR_W || (unsigned)y >= (unsigned)SCR_H) {
        return;
    }
    if (f <= 5) {
        return;
    }
    uint32_t i = (uint32_t)y * SCR_W + (uint32_t)x;
    fb[i] = (f >= 250) ? c2 : mix565(fb[i], c2, f);
}

static void fill_rect(uint16_t *fb, int x0, int y0, int x1, int y1, uint16_t c)
{
    if (x0 < 0) x0 = 0;
    if (y0 < 0) y0 = 0;
    if (x1 > SCR_W) x1 = SCR_W;
    if (y1 > SCR_H) y1 = SCR_H;
    for (int y = y0; y < y1; y++) {
        uint16_t *row = fb + (uint32_t)y * SCR_W;
        for (int x = x0; x < x1; x++) {
            row[x] = c;
        }
    }
}

static void fill_thin(uint16_t *fb, int x0, int y0, int x1, int y1, uint16_t c)
{
    fill_rect(fb, x0, y0, x1 - 1, y1 - 1, c);
}

/* ------------------------------------------------------------------- text --
 * draw_text_aa(): (x, y) is the TOP of the em box. Baseline = y + ascent.     */
static int text_w(const char *s, int size_idx, int tracking)
{
    int w = 0;
    for (; *s; s++) {
        unsigned char g = (unsigned char)*s;
        if (g < 32 || g > 126) {
            g = 32;
        }
        w += jf_glyphs[size_idx][g - 32].adv;
        if (s[1]) {
            w += tracking;
        }
    }
    return w;
}

static void draw_text_aa(uint16_t *fb, int x, int y, const char *s,
                         uint16_t color, int size_idx, int tracking)
{
    const jf_glyph_t *tab = jf_glyphs[size_idx];
    int baseline = y + jf_ascent[size_idx];

    for (; *s; s++) {
        unsigned char g = (unsigned char)*s;
        if (g < 32 || g > 126) {
            g = 32;
        }
        const jf_glyph_t *gl = &tab[g - 32];
        if (gl->w && gl->h) {
            const uint8_t *bits = jf_raster_data + gl->data_off;
            int bx = x + gl->xoff;
            int by = baseline + gl->yoff;
            for (int j = 0; j < gl->h; j++) {
                int yy = by + j;
                if ((unsigned)yy >= (unsigned)SCR_H) {
                    continue;
                }
                const uint8_t *rowbits = bits + (uint32_t)j * gl->w;
                uint32_t rowbase = (uint32_t)yy * SCR_W;
                for (int i = 0; i < gl->w; i++) {
                    int a = rowbits[i];
                    if (a < 6) {
                        continue;
                    }
                    int xx = bx + i;
                    if ((unsigned)xx >= (unsigned)SCR_W) {
                        continue;
                    }
                    uint32_t p = rowbase + (uint32_t)xx;
                    fb[p] = (a >= 250) ? color : mix565(fb[p], color, a);
                }
            }
        }
        x += gl->adv + tracking;
    }
}

static void draw_text_centered_aa(uint16_t *fb, int y, const char *s,
                                  uint16_t color, int size_idx, int tracking)
{
    draw_text_aa(fb, (SCR_W - text_w(s, size_idx, tracking)) / 2, y, s,
                 color, size_idx, tracking);
}

static void draw_label_centered_aa(uint16_t *fb, int y, const char *s,
                                   uint16_t color, int size_idx, int tracking)
{
    /* Uppercase imperative label (state word / stamped nameplates). */
    char up[32];
    size_t n = 0;
    for (; s[n] && n < sizeof(up) - 1; n++) {
        up[n] = (s[n] >= 'a' && s[n] <= 'z') ? (char)(s[n] - 32) : s[n];
    }
    up[n] = '\0';
    draw_text_centered_aa(fb, y, up, color, size_idx, tracking);
}

/* Word-wrap into rows of at most maxw px; at most maxlines rows, ellipsised
 * on overflow. Returns row count. Each out row allocations is caller-owned. */
static int wrap_text(const char *s, int size_idx, int tracking, int maxw,
                     char out[][128], int maxlines)
{
    int rows = 0;
    const char *p = s;

    while (*p && rows < maxlines) {
        int w = 0;
        const char *e = p;      /* furthest char that still fits   */
        const char *cut = NULL; /* last space within that range    */
        while (*e) {
            unsigned char g = (unsigned char)*e;
            w += (g >= 32 && g <= 126) ? jf_glyphs[size_idx][g - 32].adv : 12;
            if (e[1] && w + tracking <= maxw) {
                w += tracking;
            }
            if (w > maxw) {
                break;
            }
            if (*e == ' ') {
                cut = e;
            }
            e++;
        }
        const char *row = p;
        int row_len;
        if (*e == '\0') {
            row_len = (int)(e - p);
        } else if (cut && cut > p) {
            row_len = (int)(cut - p);
        } else {
            row_len = (int)(e - p);
        }
        while (row_len > 0 && row[row_len - 1] == ' ') {
            row_len--;
        }
        if (row_len <= 0) {
            row_len = 1;
        }
        if (row_len > 127) {
            row_len = 127;
        }
        memcpy(out[rows], row, row_len);
        out[rows][row_len] = '\0';
        rows++;

        p = row + row_len;
        while (*p == ' ') {
            p++;
        }
        if (*e == '\0') {
            break;
        }
    }
    if (*p && rows > 0) {
        /* overflow: ellipsize the last emitted row */
        char *last = out[rows - 1];
        int n = (int)strlen(last);
        while (n > 1 && text_w(last, size_idx, tracking) >
                        maxw - 2 * jf_glyphs[size_idx]['.' - 32].adv) {
            last[--n] = '\0';
        }
        if (n + 3 < 128) {
            strcpy(last + n, "...");
        }
    }
    return rows;
}

/* ------------------------------------------------------- shapes (AA) ------ */

/* Anti-aliased annulus (stroke) centred at (cx,cy), inner/outer radius. */
static void ring_aa(uint16_t *fb, int cx, int cy, float Ri, float Ro,
                    uint16_t c, int alpha)
{
    int i0 = cx - (int)Ro - 1, i1 = cx + (int)Ro + 2;
    int j0 = cy - (int)Ro - 1, j1 = cy + (int)Ro + 2;
    if (i0 < 0) i0 = 0;
    if (j0 < 0) j0 = 0;
    if (i1 > SCR_W) i1 = SCR_W;
    if (j1 > SCR_H) j1 = SCR_H;

    float ri = Ri - 0.5f, ro = Ro + 0.5f;
    for (int y = j0; y < j1; y++) {
        float dy = (float)(y - cy);
        float dy2 = dy * dy;
        for (int x = i0; x < i1; x++) {
            float dx = (float)(x - cx);
            float d = sqrtf(dx * dx + dy2);
            float cov;
            if (d >= ro) {
                cov = 0.0f;
            } else if (d > ri) {
                float in_edge = (ro - d < 1.0f) ? (ro - d) : 1.0f;
                float out_edge = (d - ri < in_edge) ? (d - ri) : in_edge;
                cov = out_edge;
            } else {
                cov = 0.0f;
            }
            if (cov > 0.0f) {
                px_a(fb, x, y, c, (int)(cov * (float)alpha));
            }
        }
    }
}

/* Tick marks radiating r0..r1, n around the circle; every 5th is long. */
static void draw_ticks(uint16_t *fb, int cx, int cy, float r0, float r1,
                       int n, uint16_t c, int alpha)
{
    for (int k = 0; k < n; k++) {
        float a = (float)k * (2.0f * (float)M_PI / (float)n);
        float ca = cosf(a), sa = sinf(a);
        bool major = (k % 5) == 0;
        float r1k = major ? r1 : r0 + (r1 - r0) * 0.55f;
        int steps = (int)(r1k - r0);
        if (steps < 1) {
            steps = 1;
        }
        int aa = major ? alpha : alpha / 2;
        for (int s = 0; s <= steps; s++) {
            float r = r0 + (r1k - r0) * (float)s / (float)steps;
            px_a(fb, cx + (int)(ca * r), cy + (int)(sa * r), c, aa);
        }
    }
}

/* Fading-arc sweep on a ring: alpha ramps head→tail, thin AA stroke. */
static void draw_sweep(uint16_t *fb, int cx, int cy, float r, float head_angle,
                       float span, uint16_t c, int alpha)
{
    const int steps = 60;
    for (int i = 0; i <= steps; i++) {
        float t = (float)i / (float)steps;
        float a = head_angle - span + span * t;
        int al = (int)(alpha * t * t * 0.3f + alpha * t * t * t * 0.7f);
        float ca = cosf(a), sa = sinf(a);
        for (int w = -1; w <= 1; w++) {
            px_a(fb, cx + (int)(ca * (r + w)), cy + (int)(sa * (r + w)), c, al);
        }
    }
}

/* -------------------------------------------------------------- chrome ---- */

static void draw_top_bar(uint16_t *fb, const jarvis_snapshot_t *s)
{
    /* wordmark + role label, left-anchored on a 32 px grid                  */
    draw_text_aa(fb, 32, 28, "JARVIS", C_TEXT_HI, 1, 10);
    draw_text_aa(fb, 32, 74, "VOICE  SATELLITE", C_TEXT_DIM, 0, 6);

    /* settings gear affordance: three hairlines, top-right well above the
     * battery cluster (tap zone = the whole strip)                          */
    for (int i = 0; i < 3; i++) {
        int yy = 20 + i * 10;
        fill_thin(fb, SCR_W - 46, yy, SCR_W - 14, yy + 2, C_TEXT_DIM);
    }
    /* right cluster: wifi arcs at ~610, battery 690..758                    */
    bool wifi = s->wifi_connected;
    {
        const float wcx = SCR_W - 190, wcy = 60;
        px_a(fb, (int)wcx, (int)wcy, wifi ? C_IDLE : C_TEXT_DIM, wifi ? 240 : 140);
        for (int k = 1; k <= 3; k++) {
            float rr = 6 + k * 5;
            const int nsteps = 16 + k * 6;
            for (int i = 0; i <= nsteps; i++) {
                float a = -(float)M_PI * 0.25f -
                          (float)M_PI * 0.5f * (float)i / (float)nsteps;
                px_a(fb, (int)(wcx + cosf(a) * rr), (int)(wcy - sinf(a) * rr),
                     wifi ? C_IDLE : C_TEXT_DIM, wifi ? 235 : 130);
            }
        }
        if (!wifi) {
            for (int i = -8; i < 8; i++) {
                px_a(fb, (int)wcx + i, (int)wcy - i / 2, C_ERR, 200);
            }
        }
    }

    {
        int bx = SCR_W - 110, by = 46, bw = 64, bh = 22;
        fill_thin(fb, bx, by, bx + bw, by + bh, C_HAIR);
        fill_thin(fb, bx + bw + 2, by + bh / 2 - 3, bx + bw + 4, by + bh / 2 + 3,
                  C_HAIR);
        if (s->battery_pct >= 0) {
            int fill_w = (bw - 6) * s->battery_pct / 100;
            fill_rect(fb, bx + 3, by + 3, bx + 3 + fill_w, by + bh - 3,
                      s->battery_pct < 15 ? C_ERR : C_TEXT_DIM);
            char pct[16];
            snprintf(pct, sizeof(pct), "%d%%", s->battery_pct);
            draw_text_aa(fb, SCR_W - 110, by + 28, pct, C_TEXT_DIM, 0, 2);
        } else {
            draw_text_aa(fb, SCR_W - 110, by + 28, "--", C_TEXT_DIM, 0, 2);
        }
    }

    fill_thin(fb, 0, 118, SCR_W, 119, C_HAIR);
}

static void draw_bottom_bar(uint16_t *fb, const jarvis_snapshot_t *s)
{
    fill_thin(fb, 0, 1236, SCR_W, 1237, C_HAIR);
    draw_text_aa(fb, 32, 1246, JARVIS_FW_VERSION, RGB565(84, 94, 110), 0, 3);
    if (s->last_total_seconds > 0.05f) {
        char lat[40];
        snprintf(lat, sizeof(lat), "TURN  %.1f s", s->last_total_seconds);
        int w = text_w(lat, 0, 3);
        draw_text_aa(fb, SCR_W - 32 - w, 1246, lat, RGB565(84, 94, 110), 0, 3);
    }
}

static void draw_approval(uint16_t *fb, float t)
{
    int x0 = 100, x1 = 700, y0 = 1124, y1 = 1224;
    uint16_t amber = C_THINK;
    fill_rect(fb, x0, y0, x1, y0 + 2, amber);
    fill_rect(fb, x0, y1 - 2, x1, y1, amber);
    fill_rect(fb, x0, y0, x0 + 2, y1, amber);
    fill_rect(fb, x1 - 2, y0, x1, y1, amber);

    draw_label_centered_aa(fb, y0 + 30, "approve turn ?", amber, 1, 6);
    draw_label_centered_aa(fb, y0 + 66, "tap to allow  ·  console: a / d",
                           RGB565(190, 140, 70), 0, 3);
    (void)t;
}

/* ------------------------------------------------------- state styling --- */

typedef struct {
    uint16_t accent;   /* primary state hue        */
    uint16_t glowc;    /* glow disc / soft variant */
    uint16_t text;     /* state word colour        */
    float    glow_i;   /* glow intensity 0..1      */
} state_style_t;

static void style_for(jarvis_state_t s, state_style_t *o)
{
    switch (s) {
    case JVS_IDLE:
        *o = (state_style_t){ C_IDLE,   C_IDLE,  C_IDLE,    0     }; break;
    case JVS_LISTENING:
        *o = (state_style_t){ C_LISTEN, C_IDLE,  C_LISTEN,  0.55f }; break;
    case JVS_THINKING:
        *o = (state_style_t){ C_THINK,  C_THINK, C_THINK,   0     }; break;
    case JVS_SPEAKING:
        *o = (state_style_t){ C_SPEAK,  C_SPEAK, C_SPEAK,   0     }; break;
    case JVS_ERROR:
        *o = (state_style_t){ C_ERR,    C_ERR,   C_ERR,     0.18f }; break;
    default:
        *o = (state_style_t){ C_IDLE,   C_IDLE,  C_TEXT_DIM,0.14f }; break;
    }
}

static void draw_status_line(uint16_t *fb, const jarvis_snapshot_t *s)
{
    const char *st = s->status[0] ? s->status : "";
    char buf[72];
    int n = 0;
    while (st[n] && n < (int)sizeof(buf) - 1) {
        buf[n] = st[n];
        n++;
    }
    while (n > 0 && text_w(buf, 0, 2) > SCR_W - 64) {
        buf[--n] = '\0';
    }
    if (text_w(buf, 0, 2) > SCR_W - 64 && n > 3) {
        buf[n - 3] = '.';
        buf[n - 2] = '.';
        buf[n - 1] = '.';
    }
    draw_text_centered_aa(fb, 1004, buf, C_TEXT_DIM, 0, 2);
}

static void draw_transcript(uint16_t *fb, const jarvis_snapshot_t *s, float t)
{
    char rows[3][128];
    int y = 1066;

    if (s->approval_pending) {
        draw_approval(fb, 0.0f);
        return;
    }

    /* latest user turn: small, dim, one line                                */
    if (s->user_text[0]) {
        wrap_text(s->user_text, 0, 2, SCR_W - 64, rows, 1);
        draw_text_aa(fb, 32, y, rows[0], RGB565(140, 150, 165), 0, 2);
    }

    /* latest assistant reply: two bright rows beside a cyan edge bar        */
    if (s->reply_text[0]) {
        int n = wrap_text(s->reply_text, 1, 1, SCR_W - 96, rows, 2);
        int rx = 56, ry = y + 38;
        if (n > 0) {
            fill_rect(fb, 28, ry - 2, 31, ry - 2 + n * 38 + 6, C_IDLE);
            for (int i = 0; i < n; i++) {
                draw_text_aa(fb, rx, ry + i * 38, rows[i], C_TEXT_HI, 1, 1);
            }
            /* blinking caret while the reply is in progress */
            int lw = text_w(rows[n - 1], 1, 1);
            int cx2 = rx + lw + 10, cy2 = ry + (n - 1) * 38 + 16;
            int blink = ((int)(t * 2.0f)) & 1 ? 190 : 40;
            px_a(fb, cx2, cy2, C_IDLE, blink);
            px_a(fb, cx2, cy2 - 1, C_IDLE, blink / 2);
            px_a(fb, cx2, cy2 + 1, C_IDLE, blink / 2);
        }
    }
}

/* ------------------------------------------------ reactor / waveform ------ */

#define WAVE_N 40

static void draw_wave_ring(uint16_t *fb, int cx, int cy, float base,
                           const float *amp, uint16_t c, int alpha)
{
    const int steps = 640;
    for (int i = 0; i <= steps; i++) {
        float a = (float)i * (2.0f * (float)M_PI) / (float)steps;
        float pos = (float)(i * WAVE_N) / (float)steps;
        int i0 = i % WAVE_N;
        int i1 = (i0 + 1) % WAVE_N;
        float rem = pos - floorf(pos);
        float r = base + (amp[i0] * (1.0f - rem) + amp[i1] * rem) * 55.0f;
        px_a(fb, cx + (int)(cosf(a) * r), cy + (int)(sinf(a) * r), c, alpha);
    }
}


/* -------------------------------------------------- on-panel settings ------
 * Wireless setup lives on the panel: a gear zone opens it, the network scan
 * list is right there, and an on-screen keyboard types the password and the
 * brain URL. Everything by touch; the serial console stays as a fallback.
 * Geometry is declared once so drawing and hit-testing can never drift.      */

#define SET_LIST_Y0   150
#define SET_ROW_H     84
#define SET_MAX_ROWS  4
#define SET_PASS_Y    500
#define SET_URL_Y     600
#define SET_APPLY_Y   696
#define KBD_Y0        800
#define KBD_KEY_W     74
#define KBD_KEY_H     60
#define KBD_ROW_STEP  (KBD_KEY_H + 6)

static volatile bool s_set_open;

static int           s_field;          /* 0 = wifi password, 1 = brain url */
static char          s_pass[65];
static char          s_url[161];
static bool          s_shift;          /* one-shot uppercase               */
static jarvis_wifi_ap_t s_aps[8];
static size_t          s_apcnt;
static volatile bool  s_scanning;
static int            s_sel = -1;       /* selected scan index              */
static const char    *s_set_msg;
static TickType_t     s_set_msg_until;

static void set_msg(const char *m)
{
    s_set_msg = m;
    s_set_msg_until = xTaskGetTickCount() + pdMS_TO_TICKS(6000);
}

static void scan_task(void *arg)
{
    (void)arg;
    size_t n = 0;
    esp_err_t e = jarvis_wifi_start(jarvis_settings()->wifi_ssid,
                                    jarvis_settings()->wifi_pass);
    s_scanning = true;
    if (e != ESP_OK) {
        set_msg("radio unavailable");
        s_scanning = false;
        vTaskDelete(NULL);
        return;
    }
    e = jarvis_wifi_scan(s_aps, &n, sizeof(s_aps) / sizeof(s_aps[0]));
    if (e == ESP_OK) {
        s_apcnt = n;
        if (n == 0) {
            set_msg("no networks found");
        }
    } else {
        set_msg("scan failed");
    }
    s_scanning = false;
    vTaskDelete(NULL);
}

static void start_scan(void)
{
    if (s_scanning) {
        return;
    }
    s_apcnt = 0;
    s_scanning = true;   /* catch the beat before the task even runs */
    if (xTaskCreatePinnedToCore(scan_task, "ui_scan", 8192, NULL, 3, NULL, 1)
        != pdPASS) {
        s_scanning = false;
        set_msg("scan: no task slots");
    }
}

static void kbd_char(char c)
{
    char *f = (s_field == 0) ? s_pass : s_url;
    size_t maxlen = (s_field == 0) ? sizeof(s_pass) - 1 : sizeof(s_url) - 1;
    size_t n = strlen(f);
    if (n >= maxlen) {
        return;
    }
    if (s_shift && c >= 'a' && c <= 'z') {
        c -= 32;
        s_shift = false;
    }
    f[n] = c;
    f[n + 1] = '\0';
}

static void kbd_del(void)
{
    char *f = (s_field == 0) ? s_pass : s_url;
    size_t n = strlen(f);
    if (n) {
        f[n - 1] = '\0';
    }
}

static void apply_fields(void)
{
    if (s_field == 0) {
        if (s_sel < 0 || s_sel >= (int)s_apcnt) {
            set_msg("tap a network first");
            return;
        }
        jarvis_settings_set_wifi(s_aps[s_sel].ssid, s_pass);
        jarvis_wifi_start(s_aps[s_sel].ssid, s_pass);
        set_msg("connecting...");
    } else {
        const jarvis_settings_t *c = jarvis_settings();
        jarvis_settings_set_server(s_url, c->conversation);
        jarvis_ws_start(jarvis_settings()->server_url);
        set_msg("brain link applying");
    }
}

static const char *const kbd_letters[3] = {
    "qwertyuiop", "asdfghjkl", "zxcvbnm",
};

static void draw_button(uint16_t *fb, int x0, int y0, int x1, int y1,
                        uint16_t border, uint16_t textc, const char *label)
{
    fill_thin(fb, x0, y0, x1, y1, border);

    /* label centred INSIDE the button box — NOT on the screen (an earlier
     * version reused the screen-centred helper, which piled every key's
     * letter into the middle of the keyboard: the overlap the field saw) */
    char up[24];
    size_t n = 0;
    for (; label[n] && n < sizeof(up) - 1; n++) {
        up[n] = (label[n] >= 'a' && label[n] <= 'z')
                ? (char)(label[n] - 32) : label[n];
    }
    up[n] = '\0';
    int tw = text_w(up, 0, 2);
    int bx = x0 + ((x1 - x0) - tw) / 2;
    if (bx < x0) {
        bx = x0;
    }
    int ty = (y0 + y1) / 2 - jf_ascent[0] / 2;
    draw_text_aa(fb, bx, ty, up, textc, 0, 2);
}

static void draw_settings(uint16_t *fb, const jarvis_snapshot_t *s)
{
    (void)s;
    fill_thin(fb, 0, 118, SCR_W, 119, C_HAIR);

    draw_button(fb, 24, 30, 220, 92, C_HAIR, C_TEXT, "BACK");
    draw_text_aa(fb, 254, 40, "WIRELESS SETUP", C_TEXT_HI, 1, 10);
    draw_button(fb, SCR_W - 180, 30, SCR_W - 24, 92, C_HAIR, C_IDLE, "RESCAN");
    fill_thin(fb, 0, 116, SCR_W, 117, C_HAIR);

    /* network list — full-width rows */
    int y = SET_LIST_Y0;
    if (s_scanning) {
        draw_text_aa(fb, 40, y + 24, "scanning ...", C_IDLE, 0, 4);
        y += SET_ROW_H;
    }
    for (int i = 0; i < (int)s_apcnt && i < SET_MAX_ROWS; i++) {
        if (i == s_sel) {
            fill_rect(fb, 24, y, SCR_W - 24, y + SET_ROW_H - 6,
                      RGB565(20, 44, 56));
            fill_rect(fb, 24, y, 28, y + SET_ROW_H - 6, C_IDLE);
        }
        char buf[40];
        snprintf(buf, sizeof(buf), "%.28s", s_aps[i].ssid);
        draw_text_aa(fb, 44, y + 22, buf, i == s_sel ? C_IDLE : C_TEXT, 0, 3);
        char rssi[16];
        snprintf(rssi, sizeof(rssi), "%d dBm", s_aps[i].rssi);
        int rw = text_w(rssi, 0, 2);
        draw_text_aa(fb, SCR_W - 44 - rw, y + 22, rssi, C_TEXT_DIM, 0, 2);
        fill_thin(fb, 24, y + SET_ROW_H - 6, SCR_W - 24, y + SET_ROW_H - 5,
                  C_HAIR);
        y += SET_ROW_H;
    }
    if (!s_scanning && s_apcnt == 0) {
        draw_text_aa(fb, 44, y + 24, "no networks yet", C_TEXT_DIM, 0, 3);
    }

    /* fields — full-width bars */
    draw_text_aa(fb, 24, SET_PASS_Y, "PASSWORD", C_TEXT_DIM, 0, 6);
    fill_thin(fb, 24, SET_PASS_Y + 34, SCR_W - 24, SET_PASS_Y + 86,
              s_field == 0 ? C_IDLE : C_HAIR);
    draw_text_aa(fb, 40, SET_PASS_Y + 48,
                 s_pass[0] ? s_pass : "(empty)", C_TEXT, 0, 2);

    draw_text_aa(fb, 24, SET_URL_Y, "BRAIN URL", C_TEXT_DIM, 0, 6);
    fill_thin(fb, 24, SET_URL_Y + 34, SCR_W - 24, SET_URL_Y + 86,
              s_field == 1 ? C_IDLE : C_HAIR);
    draw_text_aa(fb, 40, SET_URL_Y + 48,
                 s_url[0] ? s_url : "(empty)", C_TEXT, 0, 1);

    draw_button(fb, 24, SET_APPLY_Y, SCR_W - 24, SET_APPLY_Y + 64,
                s_field == 0 ? C_IDLE : C_HAIR, C_TEXT_HI,
                s_field == 0 ? "CONNECT" : "SAVE BRAIN URL");

    if (s_set_msg &&
        (int)(xTaskGetTickCount() - s_set_msg_until) < 0) {
        draw_text_aa(fb, 24, SET_APPLY_Y + 74, s_set_msg, C_THINK, 0, 2);
    }

    /* ---------------- keyboard ---------------- */
    int yk = KBD_Y0;
    for (int r = 0; r < 3; r++) {
        int count = strlen(kbd_letters[r]);
        int row_w = count * KBD_KEY_W + (count - 1) * 4;
        int x = (SCR_W - row_w) / 2;
        for (int k = 0; k < count; k++) {
            char lbl[2] = { kbd_letters[r][k], '\0' };
            draw_button(fb, x, yk, x + KBD_KEY_W, yk + KBD_KEY_H, C_HAIR,
                        C_TEXT, lbl);
            x += KBD_KEY_W + 4;
        }
        yk += KBD_ROW_STEP;
    }
    /* digits */
    int x = 16;
    for (int i = 0; i < 10; i++) {
        char lbl[2] = { (char)('0' + i), '\0' };
        draw_button(fb, x, yk, x + KBD_KEY_W, yk + KBD_KEY_H, C_HAIR, C_TEXT,
                    lbl);
        x += KBD_KEY_W + 4;
    }
    yk += KBD_ROW_STEP;
    /* special row */
    int sw = (SCR_W - 32) / 6;
    draw_button(fb, 16, yk, 16 + sw - 4, yk + KBD_KEY_H,
                s_shift ? C_IDLE : C_HAIR, s_shift ? C_IDLE : C_TEXT, "SHIFT");
    const char *syms[4] = { "@", "#", "/", "." };
    for (int i = 0; i < 4; i++) {
        draw_button(fb, 16 + (i + 1) * sw, yk, 16 + (i + 2) * sw - 4,
                    yk + KBD_KEY_H, C_HAIR, C_TEXT, syms[i]);
    }
    draw_button(fb, 16 + 5 * sw, yk, SCR_W - 16, yk + KBD_KEY_H, C_HAIR,
                C_TEXT, "DEL");
}

/* -------------------------------------------------- settings taps --------- */

static void settings_tap(uint16_t px, uint16_t py)
{
    if (px < 230 && py >= 30 && py <= 92) {
        s_set_open = false;
        s_sel = -1;
        return;
    }
    if (px >= SCR_W - 190 && py >= 30 && py <= 92) {
        start_scan();
        return;
    }

    /* network rows */
    int y = SET_LIST_Y0;
    for (int i = 0; i < (int)s_apcnt && i < SET_MAX_ROWS; i++) {
        if (py >= y && py < y + SET_ROW_H - 6) {
            s_sel = i;
            s_field = 0;
            return;
        }
        y += SET_ROW_H;
    }

    /* fields */
    if (py >= SET_PASS_Y && py < SET_PASS_Y + 92) {
        s_field = 0;
        return;
    }
    if (py >= SET_URL_Y && py < SET_URL_Y + 92) {
        s_field = 1;
        return;
    }
    /* apply */
    if (py >= SET_APPLY_Y && py < SET_APPLY_Y + 64) {
        apply_fields();
        return;
    }
    if (py < KBD_Y0) {
        return;
    }

    /* keyboard rows */
    int yk = KBD_Y0;
    for (int r = 0; r < 3; r++) {
        if (py >= yk && py < yk + KBD_KEY_H) {
            int count = strlen(kbd_letters[r]);
            int row_w = count * KBD_KEY_W + (count - 1) * 4;
            int x = (SCR_W - row_w) / 2;
            for (int k = 0; k < count; k++) {
                if (px >= x && px < x + KBD_KEY_W) {
                    kbd_char(kbd_letters[r][k]);
                    return;
                }
                x += KBD_KEY_W + 4;
            }
        }
        yk += KBD_ROW_STEP;
    }
    if (py >= yk && py < yk + KBD_KEY_H) {
        int x = 16;
        for (int i = 0; i < 10; i++) {
            if (px >= x && px < x + KBD_KEY_W) {
                kbd_char((char)('0' + i));
                return;
            }
            x += KBD_KEY_W + 4;
        }
        return;
    }
    yk += KBD_ROW_STEP;
    if (py >= yk && py < yk + KBD_KEY_H) {
        int sw = (SCR_W - 32) / 6;
        if (px < 16 + sw) { s_shift = !s_shift; return; }
        if (px < 16 + 2 * sw) { kbd_char('@'); return; }
        if (px < 16 + 3 * sw) { kbd_char('#'); return; }
        if (px < 16 + 4 * sw) { kbd_char('/'); return; }
        if (px < 16 + 5 * sw) { kbd_char('.'); return; }
        kbd_del();
        return;
    }
}

/* --------------------------------------- main-screen tap routing ------------ */

static void open_settings(void)
{
    s_set_open = true;
    s_sel = -1;
    const jarvis_settings_t *c = jarvis_settings();
    strlcpy(s_pass, c->wifi_pass, sizeof(s_pass));
    strlcpy(s_url, c->server_url, sizeof(s_url));
    s_field = 0;
    start_scan();
}

static void main_tap(uint16_t px, uint16_t py)
{
    /* the whole top strip opens the settings sheet */
    if (py <= 110) {
        open_settings();
        return;
    }
    jarvis_state_touch_pulse();
    jarvis_turn_toggle();
}

/* ------------------------------------------------------- axis wizard ----- */

void jarvis_ui_tap(uint16_t x, uint16_t y)
{
    if (s_set_open) {
        settings_tap(x, y);
        return;
    }
    main_tap(x, y);
}


/* ------------------------------------------------------------------- task -- */

static void ui_task(void *arg)
{
    (void)arg;
    float wave[WAVE_N] = { 0 };
    float t = 0.0f;

    const int cx = SCR_W / 2;
    const int cy = 560;
    const float R = 250.0f;

    jarvis_snapshot_t snap;
    while (true) {
        uint16_t *fb = bsp_display_framebuffer();
        if (fb) {
            jarvis_state_copy(&snap);

            if (s_set_open) {
                /* settings sheet gets the whole frame */
                fill_rect(fb, 0, 0, SCR_W, SCR_H, C_BG);
                draw_settings(fb, &snap);
                bsp_display_flush(0, 0, SCR_W, SCR_H);
                t += 1.0f / JARVIS_UI_FPS;
                vTaskDelay(pdMS_TO_TICKS(1000 / JARVIS_UI_FPS));
                continue;
            }

            state_style_t st;
            style_for(snap.state, &st);

            /* background: one flat neutral colour (no banding) */
            fill_rect(fb, 0, 0, SCR_W, SCR_H, C_BG);

            /* tap ripple: expanding ring for ~0.7 s after a touch */
            {
                TickType_t now_t = xTaskGetTickCount();
                int age_ms = (int)((now_t - snap.tap_ticks) * portTICK_PERIOD_MS);
                if (age_ms >= 0 && age_ms < 700 && (snap.tap_ticks != 0)) {
                    float rr = R + (float)age_ms * 0.22f;
                    int ra = (int)(210 * (1.0f - (float)age_ms / 700.0f));
                    ring_aa(fb, cx, cy, rr - 4.0f, rr + 2.0f, st.accent, ra);
                }
            }

            /* reactor */
            ring_aa(fb, cx, cy, R - 1.2f, R + 1.2f, st.accent, 115);
            ring_aa(fb, cx, cy, R * 0.82f - 0.6f, R * 0.82f + 0.6f, st.accent, 55);
            ring_aa(fb, cx, cy, R * 0.40f - 0.5f, R * 0.40f + 0.5f, st.accent, 38);

            draw_ticks(fb, cx, cy, R * 1.07f, R * 1.14f, 24, st.accent, 130);

            switch (snap.state) {
            case JVS_LISTENING: {
                float lv = jarvis_audio_mic_level();
                for (int i = WAVE_N - 1; i > 0; i--) {
                    wave[i] = wave[i - 1] * 0.94f;
                }
                wave[0] = lv;
                draw_wave_ring(fb, cx, cy, R * 0.60f, wave, C_LISTEN, 200);
                draw_sweep(fb, cx, cy, R * 0.82f, t * 3.4f, (float)M_PI / 2.0f,
                           C_LISTEN, 210);
            } break;
            case JVS_SPEAKING: {
                for (int i = WAVE_N - 1; i > 0; i--) {
                    wave[i] = wave[i - 1] * 0.93f;
                }
                wave[0] = 0.20f + 0.14f * fabsf(sinf(t * 5.2f)) +
                          0.08f * fabsf(sinf(t * 2.1f + 1.3f));
                draw_wave_ring(fb, cx, cy, R * 0.60f, wave, C_SPEAK, 190);
            } break;
            case JVS_THINKING: {
                float a = t * 2.8f;
                draw_sweep(fb, cx, cy, R * 0.82f, a + (float)M_PI,
                           (float)M_PI * 2.0f / 3.0f, C_THINK, 215);
            } break;
            case JVS_ERROR: {
                draw_sweep(fb, cx, cy, R * 0.82f, t * 0.9f, (float)M_PI / 3.0f,
                           C_ERR, 200);
            } break;
            default: {  /* idle + booting */
                float a = t * 0.85f;
                draw_sweep(fb, cx, cy, R * 0.82f, a, (float)M_PI / 3.0f,
                           st.accent, 140);
            } break;
            }

            /* core: bright dot + thin companion ring, breathing */
            float pulse = 0.72f + 0.28f * (0.5f + 0.5f * sinf(t * 3.2f));
            ring_aa(fb, cx, cy, 0.0f, 7.0f * pulse, st.accent, 240);
            ring_aa(fb, cx, cy, 11.0f, 12.6f, st.accent, 95);

            draw_top_bar(fb, &snap);

            /* state word + status line */
            draw_label_centered_aa(fb, 936,
                                   jarvis_state_name(snap.state), st.text, 2, 14);
            draw_status_line(fb, &snap);

            fill_thin(fb, 0, 1046, SCR_W, 1047, C_HAIR);
            draw_transcript(fb, &snap, t);
            draw_bottom_bar(fb, &snap);

            bsp_display_flush(0, 0, SCR_W, SCR_H);
        }

        t += 1.0f / JARVIS_UI_FPS;
        vTaskDelay(pdMS_TO_TICKS(1000 / JARVIS_UI_FPS));
    }
}

esp_err_t jarvis_ui_init(void)
{
    BaseType_t ok = xTaskCreatePinnedToCore(ui_task, "jarvis_ui", 8192, NULL, 4,
                                            NULL, 1);
    return (ok == pdPASS) ? ESP_OK : ESP_FAIL;
}
